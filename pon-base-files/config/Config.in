## pon-base-files/config/Config.in
```kconfig
config PON_SDK_VERSION
	string "PON release version number"
	default "2.1.0"

config PON_BASE_FILES_COPY
	bool "Copy PON base files for version information"
```
